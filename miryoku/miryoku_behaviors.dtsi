// Copyright 2022 Manna Harbour
// https://github.com/manna-harbour/miryoku

/ {
  behaviors {
    u_mt: u_mt {
      compatible = "zmk,behavior-hold-tap";
      #binding-cells = <2>;
      flavor = "tap-unless-interrupted";
      tapping-term-ms = <100>;                        // <---[[produces tap if held longer than tapping-term-ms]]
      quick-tap-ms = <200>;
      bindings = <&kp>, <&kp>;
    };
    u_lt: u_lt {
      compatible = "zmk,behavior-hold-tap";
      #binding-cells = <2>;
      flavor = "tap-unless-interrupted";
      tapping-term-ms = <100>;                        // <---[[produces tap if held longer than tapping-term-ms]]
      quick-tap-ms = <200>;
      bindings = <&mo>, <&kp>;
    };
  };
};
